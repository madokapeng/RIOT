## boards/esp8266-wifi-shield/Kconfig
```kconfig
# Copyright (c) 2021 madokapeng
#
# This file is subject to the terms and conditions of the GNU Lesser
# General Public License v2.1. See the file LICENSE in the top level
# directory for more details.

config BOARD
    default "esp8266-wifi-shield" if BOARD_ESP8266_WIFI_SHIELD

config BOARD_ESP8266_WIFI_SHIELD
    bool
    default y
    select BOARD_COMMON_ESP8266
    select CPU_MODEL_ESP8266_ESP_12X

source "$(RIOTBOARD)/common/esp8266/Kconfig"
```
